## sdkconfig.defaults
```kconfig
# WiFi Configuration
CONFIG_ESP_WIFI_MBEDTLS_TLS_ENABLED=y
CONFIG_ESP_WIFI_WPA3_SAE_PWE_H2E=y
CONFIG_ESP_WIFI_WPA3_SAE_H2E_IDENTIFIER=""
CONFIG_ESP_WIFI_WPA3_CNF_SAKA_NUM_RETRIES=2
CONFIG_ESP_WIFI_WPA3_SAE_PK_NUM_RETRIES=2

# SNTP Configuration
CONFIG_LWIP_SNTP_MAX_SERVERS=3
CONFIG_LWIP_SNTP_STARTUP_MAX_SYNC_COUNT=10
CONFIG_LWIP_SNTP_UPDATE_INTERVAL=600000

# Log Configuration
CONFIG_LOG_DEFAULT_LEVEL_1_INFO=y
CONFIG_LOG_MAXIMUM_LEVEL_1_INFO=y

# SPIRAM (for ESP32-S3-EYE)
CONFIG_ESP32S3_SPIRAM_SUPPORT=y
CONFIG_SPIRAM_MODE_OCT=y
CONFIG_SPIRAM_SPEED_80M=y

# FreeRTOS Timer Task Stack (increase to prevent stack overflow)
CONFIG_FREERTOS_TIMER_TASK_STACK_SIZE=12288

# Main task stack size
CONFIG_FREERTOS_MAIN_TASK_STACK_SIZE=8192
```
